## prj.conf
```kconfig
# UART support
CONFIG_SERIAL=y


# CONFIG_MAIN_STACK_SIZE=8192
#CONFIG_LOG_PROCESS_THREAD_STACK_SIZE=
CONFIG_ENTROPY_GENERATOR=y
CONFIG_TEST_RANDOM_GENERATOR=y
CONFIG_INIT_STACKS=y
CONFIG_HW_STACK_PROTECTION=y
CONFIG_NEWLIB_LIBC=y
CONFIG_POSIX_API=y
CONFIG_POSIX_MAX_FDS=6
# CONFIG_SNTP=y
CONFIG_JSON_LIBRARY=y
CONFIG_GPIO=y
CONFIG_BT=y
CONFIG_BT_OBSERVER=y
CONFIG_BT_BROADCASTER=y
CONFIG_BT_CTLR_ADV_EXT=y
CONFIG_BT_EXT_ADV=y
CONFIG_BT_CENTRAL=y
#CONFIG_BT_SCAN=y
#CONFIG_BT_SCAN_FILTER_ENABLE=y
CONFIG_BT_FILTER_ACCEPT_LIST=y
#CONFIG_BT_WHITELIST=y
#CONFIG_BT_SETTINGS=y
#CONFIG_SETTINGS=y

# Enable Extended Scanning
CONFIG_BT_EXT_ADV=y
CONFIG_BT_EXT_SCAN_BUF_SIZE=1650
CONFIG_BT_CTLR_ADV_DATA_LEN_MAX=1650

# Zephyr Bluetooth LE Controller needs 16 event buffers to generate Extended
# Advertising Report for receiving the complete 1650 bytes of data
CONFIG_BT_BUF_EVT_RX_COUNT=20

# Set maximum scan data length for Extended Scanning in Bluetooth LE Controller
CONFIG_BT_CTLR_SCAN_DATA_LEN_MAX= 1650

# Increase Zephyr Bluetooth LE Controller Rx buffer to receive complete chain
# of PDUs
CONFIG_BT_CTLR_RX_BUFFERS=16

CONFIG_BT_CTLR_FAL_SIZE=8

#PERIODIC SCANNING CONFIGURATION 
CONFIG_BT_PER_ADV_SYNC=y
CONFIG_BT_CTLR_SYNC_PERIODIC=y
CONFIG_BT_PER_ADV_SYNC_BUF_SIZE=1650
CONFIG_BT_CTLR_SDC_PERIODIC_SYNC_BUFFER_COUNT=10

CONFIG_SERIAL=y
CONFIG_LOG=y

#############
CONFIG_NEWLIB_LIBC=y
CONFIG_BT_PER_ADV_SYNC_MAX=4
CONFIG_BT_LL_SW_SPLIT=y
CONFIG_BT_LL_SOFTDEVICE=y
CONFIG_LOG_MODE_MINIMAL=y
#LED
# CONFIG_SPI=n
# CONFIG_LOG=n

CONFIG_I2S=y
CONFIG_WS2812_STRIP=y
CONFIG_WS2812_STRIP_I2S=y
CONFIG_LED_STRIP=y
```

## src/main.c
```c
/*
 * Copyright (c) 2022 Nordic Semiconductor ASA
 *
 * SPDX-License-Identifier: Apache-2.0
 */

#include <zephyr/kernel.h>
#include <zephyr/sys/printk.h>
#include <zephyr/bluetooth/bluetooth.h>

int observer_start(void);

static void set_random_static_address(void)
{
int err;
        int err1;
	printk("Starting iBeacon Demo\n");
        
		bt_addr_le_t addr;

		//convert the string into a binary address and stores this address in a buffer whose address is addr. 
		err=bt_addr_le_from_str("DE:AD:BE:AF:BA:11","random" , &addr);  //Only random static address can be given when the type is set to "random"
        if (err) {
			printk("Invalid BT address (err %d)\n", err);
		}

                //create a new Identity address. This must be done before enabling Bluetooth. Addr is the address used for the new identity
		err1=bt_id_create(&addr, NULL);
                if (err1 < 0) {
			printk("Creating new ID failed (err %d)\n", err1);
		}
            printk("Created new address\n");
 }

int main(void)
{
	int err;

	printk("Starting Observer Demo\n");

	set_random_static_address();

	/* Initialize the Bluetooth Subsystem */
	err = bt_enable(NULL);
	if (err) {
		printk("Bluetooth init failed (err %d)\n", err);
		return;
	}

	(void)observer_start();

	// printk("Exiting %s thread.\n", __func__);
	return 0;
}
```

## src/observer.c
```c
#include <stddef.h>
#include "headers/main_observer.h"
#include <zephyr/bluetooth/bluetooth.h>
#include <zephyr/bluetooth/hci.h>
#include <zephyr/sys/printk.h>
#include <zephyr/pm/pm.h>
#include <hal/nrf_gpio.h>
#include <zephyr/devicetree.h>
#include <stdio.h>
#include <math.h>

#include <errno.h>
#include <string.h>
#define LOG_LEVEL 4
#include <zephyr/logging/log.h>
#include <zephyr/kernel.h>
#include <zephyr/zephyr.h>
#include <zephyr/device.h>
#include <zephyr/drivers/gpio.h>
#include <zephyr/sys/util.h>

#define DELAY_TIME K_MSEC(1000)

// Define remote devices
uint8_t remote1 = 1;
uint8_t remote2 = 2;

/* GPIO pin definitions for LEDs on the board */
#define LED1_NODE DT_ALIAS(led1)
static const struct gpio_dt_spec led1 = GPIO_DT_SPEC_GET(LED1_NODE, gpios);

#define LED0_NODE DT_ALIAS(led0)
static const struct gpio_dt_spec led0 = GPIO_DT_SPEC_GET(LED0_NODE, gpios);

#define LED2_NODE DT_ALIAS(led2)
static const struct gpio_dt_spec led2 = GPIO_DT_SPEC_GET(LED2_NODE, gpios);

#define STACKSIZE 2048   // Stack size for threads
#define THREAD0_PRIORITY 7  // Thread priority

// Variables to manage remote counters and connection state
static int connection_flag = 0;
static int counter_remote1 = 0;
static int counter_remote2 = 0;
LOG_MODULE_DECLARE(gateway, LOG_LEVEL_DBG);  // Declare log module for the gateway

/* It is data callback function. It is executed whenever the system receives an advertising packet. */
#if defined(CONFIG_BT_EXT_ADV)
static bool data_cb(struct bt_data *data, void *user_data)
{
	/* data_cb is executed whenever some advertising packet comes. */
	LOG_INF("IN DATA CB");  // Log message for entering data callback

	// Check the type of Bluetooth advertising data
	switch (data->type)
	{
	case BT_DATA_NAME_SHORTENED:
	case BT_DATA_NAME_COMPLETE:
	case BT_DATA_MANUFACTURER_DATA:

		int index = 0;
		uint8_t write_array[3]; // Store received data (max 3 bytes)
		write_array[0] = 0;

		/* Copy data into write_array */
		for (int j = 0; j < 3; j++)
		{
			char number = data->data[j + index];
			write_array[j] = number;
			printk("%d ", write_array[j]); // Print the received byte
		}

		// Handle remote 1 (example remote device with identifier 1)
		if (write_array[0] == remote1)
		{
			counter_remote1++;
			if (counter_remote1 == 1)
			{
				// Turn on the board LED
				gpio_pin_configure_dt(&led0, GPIO_OUTPUT | GPIO_ACTIVE_LOW);
				gpio_pin_set_dt(&led0, 1); // Set LED to ON
			}
			else if (counter_remote1 == 2)
			{
				// Turn off the board LED
				gpio_pin_configure_dt(&led0, GPIO_OUTPUT | GPIO_ACTIVE_LOW);
				gpio_pin_set_dt(&led0, 0); // Set LED to OFF
				counter_remote1 = 0;
			}
		}
		// Handle remote 2 (example remote device with identifier 2)
		if (write_array[0] == remote2)
		{
			counter_remote2++;
			if (counter_remote2 == 1)
			{
				// Turn on the board LED
				gpio_pin_configure_dt(&led0, GPIO_OUTPUT | GPIO_ACTIVE_LOW);
				gpio_pin_set_dt(&led0, 1); // Set LED to ON
			}
			else if (counter_remote2 == 2)
			{
				// Turn off the board LED
				gpio_pin_configure_dt(&led0, GPIO_OUTPUT | GPIO_ACTIVE_LOW);
				gpio_pin_set_dt(&led0, 0); // Set LED to OFF
				counter_remote2 = 0;
			}
		}
	}
	return true;
}
#endif /* CONFIG_BT_EXT_ADV */

// Scan callback function for handling received BLE advertising packets
static void scan_recv(const struct bt_le_scan_recv_info *info, struct net_buf_simple *buf)
{
	/* Executed when we receive the packet from the advertising node. */
	char le_addr[BT_ADDR_LE_STR_LEN];
	uint8_t data_status;
	uint16_t data_len;
	char name[30];   // Name of the device (advertising data)

	data_len = buf->len;
	bt_data_parse(buf, data_cb, name); // Parse the advertisement data and call data_cb

	data_status = BT_HCI_LE_ADV_EVT_TYPE_DATA_STATUS(info->adv_props);
	// Convert the Bluetooth address to string and print it
	bt_addr_le_to_str(info->addr, le_addr, sizeof(le_addr));
}

static struct bt_le_scan_cb scan_callbacks = {
	.recv = scan_recv,
};

int observer_start(void)
{
	bt_addr_le_t addr1;

	bt_addr_le_from_str("DE:AD:BE:AF:BA:11", "random", &addr1); // Convert MAC address to bt_addr_le_t structure

	int err = bt_le_filter_accept_list_add(&addr1);  // Add address to the filter accept list
	if (err == 0)
	{
		printk("Successfully added the address to Filter Accept List..\n");
	}
	else
	{
		printk("Failed to update Filter Accept List..\n");
	}

	struct bt_le_scan_param scan_param = {
		.type = BT_LE_SCAN_TYPE_PASSIVE,
		.options = BT_LE_SCAN_OPT_FILTER_DUPLICATE | BT_LE_SCAN_OPT_FILTER_ACCEPT_LIST,
		.interval = 0x0030,
		.window = 0x0030,
	};

	bt_le_scan_cb_register(&scan_callbacks);
	err = bt_le_scan_start(&scan_param, NULL);

	if (err)
	{
		LOG_INF("Start scanning failed (err %d)\n", err);
		return err;
	}
	LOG_INF("Started scanning...\n");
	return 0;
}

// Initialize the observer (Bluetooth setup and configuration)
int init_observer(void)
{
	/* Observer Initialization. */
	LOG_ERR("observer init.....");

	/* Enabling Bluetooth. */
	int err = bt_enable(NULL);
	if (err)
	{
		LOG_ERR("Bluetooth init failed (err %d)\n", err);
		return err;
	}

	return 0;
}
```
